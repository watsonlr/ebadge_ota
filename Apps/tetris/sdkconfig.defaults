## Apps/tetris/sdkconfig.defaults
```kconfig
# ESP-IDF target selection
CONFIG_IDF_TARGET="esp32s3"

# Serial flasher config
CONFIG_ESPTOOLPY_FLASHSIZE_4MB=y
CONFIG_ESPTOOLPY_FLASHSIZE="4MB"

# Partition table
CONFIG_PARTITION_TABLE_SINGLE_APP_LARGE=y

# FreeRTOS
CONFIG_FREERTOS_HZ=1000

# ESP32S3 specific
CONFIG_ESP32S3_DEFAULT_CPU_FREQ_240=y

# Compiler options
CONFIG_COMPILER_OPTIMIZATION_PERF=y

# SPI RAM (disabled for N8 variant)
CONFIG_SPIRAM=n
```

## main/Kconfig.projbuild
```kconfig
# ESP32-S3 OTA Loader Configuration

menu "OTA Loader Configuration"

  config WIFI_SSID
    string "WiFi SSID"
    default "BYUI_Visitor"
        help
            SSID (network name) for the ESP32 to connect to.

  config WIFI_PASSWORD
    string "WiFi Password (leave empty for open network)"
    default ""
        help
            WiFi password (WPA or WPA2) for the ESP32 to use.

    config WIFI_MAXIMUM_RETRY
        int "Maximum retry attempts"
        default 5
        help
            Set the maximum number of retry attempts for WiFi connection.

    config MANIFEST_URL
        string "App Manifest URL"
        default "http://192.168.1.100:8080/manifest.json"
        help
            URL of the JSON manifest file containing available apps.
            
            Example manifest format:
            {
              "apps": [
                {
                  "name": "LED Controller",
                  "version": "1.0.0",
                  "url": "http://192.168.1.100:8080/apps/led_ctrl.bin"
                }
              ]
            }

endmenu
```

## sdkconfig.defaults
```kconfig
# ESP32-C3 OTA Loader Default Configuration
# These settings will be used if not overridden by menuconfig

# Target chip
CONFIG_IDF_TARGET="esp32c3"

# Partition table
CONFIG_PARTITION_TABLE_CUSTOM=y
CONFIG_PARTITION_TABLE_CUSTOM_FILENAME="partitions.csv"
CONFIG_PARTITION_TABLE_FILENAME="partitions.csv"

# Serial flasher config
CONFIG_ESPTOOLPY_FLASHSIZE_4MB=y
CONFIG_ESPTOOLPY_FLASHSIZE="4MB"

# Bootloader config
CONFIG_BOOTLOADER_LOG_LEVEL_INFO=y

# Compiler options
CONFIG_COMPILER_OPTIMIZATION_SIZE=y

# Wi-Fi
CONFIG_ESP_WIFI_STATIC_RX_BUFFER_NUM=10
CONFIG_ESP_WIFI_DYNAMIC_RX_BUFFER_NUM=32
CONFIG_ESP_WIFI_DYNAMIC_TX_BUFFER_NUM=32

# LWIP
CONFIG_LWIP_MAX_SOCKETS=10

# HTTP Client
CONFIG_ESP_HTTP_CLIENT_ENABLE_HTTPS=y

# mbedTLS
CONFIG_MBEDTLS_CERTIFICATE_BUNDLE=y
CONFIG_MBEDTLS_CERTIFICATE_BUNDLE_DEFAULT_FULL=y

# FreeRTOS
CONFIG_FREERTOS_HZ=1000

# ESP System Settings
CONFIG_ESP_TASK_WDT_TIMEOUT_S=10
CONFIG_ESP_MAIN_TASK_STACK_SIZE=8192

# Log output
CONFIG_LOG_DEFAULT_LEVEL_INFO=y

# USB
CONFIG_ESP_CONSOLE_USB_SERIAL_JTAG=y
CONFIG_ESP_CONSOLE_SECONDARY_NONE=y
```
