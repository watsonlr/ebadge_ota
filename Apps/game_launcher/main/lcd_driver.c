/**
 * @file lcd_driver.c
 * @brief ILI9341 LCD display driver for ESP32-S3 e-Badge
 */

#include "lcd_driver.h"
#include "driver/gpio.h"
#include "driver/spi_master.h"
#include "esp_log.h"
#include "freertos/FreeRTOS.h"
#include "freertos/task.h"
#include <string.h>

// LCD Pins
#define PIN_MOSI   11
#define PIN_CLK    12
#define PIN_CS     9
#define PIN_DC     13
#define PIN_RST    48

// ILI9341 Commands
#define CMD_SWRESET   0x01
#define CMD_SLPOUT    0x11
#define CMD_DISPON    0x29
#define CMD_CASET     0x2A
#define CMD_PASET     0x2B
#define CMD_RAMWR     0x2C
#define CMD_MADCTL    0x36
#define CMD_COLMOD    0x3A

static const char *TAG = "lcd";
static spi_device_handle_t spi;

// Simple 8x8 font for faster rendering
static const uint8_t font8x8[96][8] = {
    {0x00, 0x00, 0x00, 0x00, 0x00,0x00, 0x00, 0x00}, // Space
    {0x18, 0x3C, 0x3C, 0x18, 0x18, 0x00, 0x18, 0x00}, // !
    {0x36, 0x36, 0x00, 0x00, 0x00, 0x00, 0x00, 0x00}, // "
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    {0x00, 0x00, 0x00, 0x00, 0x00, 0x00, 0x00, 0x00}  // DEL
};

static void lcd_cmd(uint8_t cmd) {
    gpio_set_level(PIN_DC, 0);
    spi_transaction_t t = {.length=8, .tx_buffer=&cmd};
    spi_device_polling_transmit(spi, &t);
}

static void lcd_data(const uint8_t *data, int len) {
    if (len == 0) return;
    gpio_set_level(PIN_DC, 1);
    spi_transaction_t t = {.length=len*8, .tx_buffer=data};
    spi_device_polling_transmit(spi, &t);
}

esp_err_t lcd_init(void) {
    ESP_LOGI(TAG, "Initializing LCD");
    
    // Configure GPIO for DC and RST
    gpio_config_t io = {
        .pin_bit_mask = (1ULL<<PIN_DC) | (1ULL<<PIN_RST),
        .mode = GPIO_MODE_OUTPUT,
    };
    gpio_config(&io);
    
    // Initialize SPI bus
    spi_bus_config_t bus = {
        .mosi_io_num = PIN_MOSI,
        .sclk_io_num = PIN_CLK,
        .miso_io_num = -1,
        .quadwp_io_num = -1,
        .quadhd_io_num = -1,
        .max_transfer_sz = 4096,
    };
    ESP_ERROR_CHECK(spi_bus_initialize(SPI2_HOST, &bus, SPI_DMA_CH_AUTO));
    
    // Add SPI device
    spi_device_interface_config_t dev = {
        .clock_speed_hz = 40*1000*1000,  // 40MHz
        .mode = 0,
        .spics_io_num = PIN_CS,
        .queue_size = 7,
    };
    ESP_ERROR_CHECK(spi_bus_add_device(SPI2_HOST, &dev, &spi));
    
    // Hardware reset
    gpio_set_level(PIN_RST, 0);
    vTaskDelay(pdMS_TO_TICKS(100));
    gpio_set_level(PIN_RST, 1);
    vTaskDelay(pdMS_TO_TICKS(100));
    
    // Initialize display
    lcd_cmd(CMD_SWRESET);
    vTaskDelay(pdMS_TO_TICKS(150));
    lcd_cmd(CMD_SLPOUT);
    vTaskDelay(pdMS_TO_TICKS(500));
    
    // Set 16-bit color mode
    lcd_cmd(CMD_COLMOD);
    uint8_t d1 = 0x55;  // 16-bit RGB565
    lcd_data(&d1, 1);
    
    // Set rotation (landscape)
    lcd_cmd(CMD_MADCTL);
    uint8_t d2 = 0x08;  // MY=0, MX=0, MV=0, BGR=1 (no mirroring)
    lcd_data(&d2, 1);
    
    lcd_cmd(CMD_DISPON);
    vTaskDelay(pdMS_TO_TICKS(200));  // Increased delay for display stabilization
    
    ESP_LOGI(TAG, "LCD initialized successfully");
    return ESP_OK;
}

void lcd_set_window(uint16_t x0, uint16_t y0, uint16_t x1, uint16_t y1) {
    uint8_t data[4];
    lcd_cmd(CMD_CASET);
    data[0] = x0>>8; data[1] = x0&0xFF; data[2] = x1>>8; data[3] = x1&0xFF;
    lcd_data(data, 4);
    lcd_cmd(CMD_PASET);
    data[0] = y0>>8; data[1] = y0&0xFF; data[2] = y1>>8; data[3] = y1&0xFF;
    lcd_data(data, 4);
    lcd_cmd(CMD_RAMWR);
}

void lcd_fill_screen(uint16_t color) {
    lcd_fill_rect(0, 0, LCD_WIDTH, LCD_HEIGHT, color);
}

void lcd_draw_pixel(int x, int y, uint16_t color) {
    if (x < 0 || x >= LCD_WIDTH || y < 0 || y >= LCD_HEIGHT) return;
    lcd_set_window(x, y, x, y);
    uint8_t c[2] = {color>>8, color&0xFF};
    lcd_data(c, 2);
}

void lcd_fill_rect(int x, int y, int w, int h, uint16_t color) {
    if (x < 0 || x >= LCD_WIDTH || y < 0 || y >= LCD_HEIGHT) return;
    if (x + w > LCD_WIDTH) w = LCD_WIDTH - x;
    if (y + h > LCD_HEIGHT) h = LCD_HEIGHT - y;
    
    lcd_set_window(x, y, x+w-1, y+h-1);
    uint8_t c[2] = {color>>8, color&0xFF};
    for (int i=0; i<w*h; i++) {
        lcd_data(c, 2);
    }
}

void lcd_draw_rect(int x, int y, int w, int h, uint16_t color) {
    // Top and bottom
    for (int i = 0; i < w; i++) {
        lcd_draw_pixel(x + i, y, color);
        lcd_draw_pixel(x + i, y + h - 1, color);
    }
    // Left and right
    for (int i = 0; i < h; i++) {
        lcd_draw_pixel(x, y + i, color);
        lcd_draw_pixel(x + w - 1, y + i, color);
    }
}

void lcd_draw_circle(int x0, int y0, int radius, uint16_t color) {
    int x = radius;
    int y = 0;
    int err = 0;
    
    while (x >= y) {
        lcd_draw_pixel(x0 + x, y0 + y, color);
        lcd_draw_pixel(x0 + y, y0 + x, color);
        lcd_draw_pixel(x0 - y, y0 + x, color);
        lcd_draw_pixel(x0 - x, y0 + y, color);
        lcd_draw_pixel(x0 - x, y0 - y, color);
        lcd_draw_pixel(x0 - y, y0 - x, color);
        lcd_draw_pixel(x0 + y, y0 - x, color);
        lcd_draw_pixel(x0 + x, y0 - y, color);
        
        if (err <= 0) {
            y += 1;
            err += 2*y + 1;
        }
        if (err > 0) {
            x -= 1;
            err -= 2*x + 1;
        }
    }
}

void lcd_fill_circle(int x0, int y0, int radius, uint16_t color) {
    for (int y = -radius; y <= radius; y++) {
        for (int x = -radius; x <= radius; x++) {
            if (x*x + y*y <= radius*radius) {
                lcd_draw_pixel(x0 + x, y0 + y, color);
            }
        }
    }
}

void lcd_draw_char(int x, int y, char c, uint16_t color, uint16_t bg) {
    if (c < 32 || c > 127) c = 32;
    int idx = c - 32;
    
    // Draw background rect first (fast) - 16x16 for 2x scaled font
    lcd_fill_rect(x, y, 16, 16, bg);
    
    // Then draw only foreground pixels (2x scaled)
    for (int row = 0; row < 8; row++) {
        uint8_t line = (idx < 96) ? font8x8[idx][row] : 0;
        for (int col = 0; col < 8; col++) {
            if (line & (1 << col)) {
                // Draw 2x2 block for each foreground pixel
                lcd_draw_pixel(x + col*2, y + row*2, color);
                lcd_draw_pixel(x + col*2 + 1, y + row*2, color);
                lcd_draw_pixel(x + col*2, y + row*2 + 1, color);
                lcd_draw_pixel(x + col*2 + 1, y + row*2 + 1, color);
            }
        }
    }
}

void lcd_draw_string(int x, int y, const char* str, uint16_t color, uint16_t bg) {
    int cx = x;
    while (*str) {
        lcd_draw_char(cx, y, *str++, color, bg);
        cx += 16;  // 2x scaled font spacing
    }
}

void lcd_draw_number(int x, int y, uint32_t num, uint16_t color, uint16_t bg) {
    char buf[12];
    snprintf(buf, sizeof(buf), "%lu", (unsigned long)num);
    lcd_draw_string(x, y, buf, color, bg);
}

void lcd_write_data_buffer(const uint16_t* data, uint32_t len) {
    gpio_set_level(PIN_DC, 1);
    // Convert to bytes and send
    uint8_t* byte_data = (uint8_t*)data;
    spi_transaction_t t = {.length = len * 16, .tx_buffer = byte_data};
    spi_device_polling_transmit(spi, &t);
}
